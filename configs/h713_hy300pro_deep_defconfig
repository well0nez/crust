## configs/h713_hy300pro_deep_defconfig
```kconfig
CONFIG_PLATFORM_H713=y
CONFIG_CIR=y
CONFIG_CIR_PROTO_NECX=y
CONFIG_CIR_WAKE_CODE=0x00ff14
CONFIG_CIR_USE_OSC24M=y
CONFIG_I2C_PINS_NONE=y
# CONFIG_SERIAL is not set
CONFIG_DEBUG_RECORD_STEPS=y
CONFIG_H713_DRAM_SELF_REFRESH=y
CONFIG_H713_DRAM_CLK=636
CONFIG_H713_DEEP_SLEEP=y
# CONFIG_H713_HOSC_IS_DCXO is not set
# CONFIG_H713_DEEP_PLL_LDO is not set
# CONFIG_H713_DEEP_VDD_SYS is not set
CONFIG_H713_BOARD_ID=2
```

## configs/h713_hy300pro_sr_defconfig
```kconfig
CONFIG_PLATFORM_H713=y
CONFIG_CIR=y
CONFIG_CIR_PROTO_NECX=y
CONFIG_CIR_WAKE_CODE=0x00ff14
CONFIG_CIR_USE_OSC24M=y
CONFIG_I2C_PINS_NONE=y
# CONFIG_SERIAL is not set
CONFIG_DEBUG_RECORD_STEPS=y
CONFIG_DEBUG_VERIFY_DRAM=y
CONFIG_H713_DRAM_SELF_REFRESH=y
CONFIG_H713_DRAM_CLK=636
CONFIG_H713_BOARD_ID=2
```

## configs/h713_hy310_deep_blobparity_defconfig
```kconfig
CONFIG_PLATFORM_H713=y
CONFIG_CIR=y
CONFIG_CIR_PROTO_NECX=y
CONFIG_CIR_WAKE_CODE=0x00ff14
CONFIG_CIR_USE_OSC24M=y
CONFIG_I2C_PINS_NONE=y
# CONFIG_SERIAL is not set
CONFIG_DEBUG_RECORD_STEPS=y
CONFIG_H713_DRAM_SELF_REFRESH=y
CONFIG_H713_DEEP_SLEEP=y
CONFIG_H713_HOSC_IS_DCXO=y
CONFIG_H713_DEEP_PLL_LDO=y
CONFIG_H713_DEEP_VDD_SYS=y
CONFIG_H713_BOARD_ID=1
CONFIG_H713_LED_RED_PIN=0
CONFIG_H713_LED_BLUE_PIN=1
```

## configs/h713_hy310_serial_defconfig
```kconfig
CONFIG_PLATFORM_H713=y
CONFIG_CIR=y
CONFIG_CIR_PROTO_NECX=y
CONFIG_CIR_USE_OSC24M=y
CONFIG_I2C_PINS_NONE=y
CONFIG_SERIAL=y
CONFIG_SERIAL_DEV_R_UART=y
CONFIG_SERIAL_BAUD=115200
CONFIG_DEBUG_LOG=y
CONFIG_DEBUG_RECORD_STEPS=y
CONFIG_H713_BOARD_ID=1
```

## drivers/watchdog/Kconfig
```kconfig
#
# Copyright © 2022 The Crust Firmware Authors.
# SPDX-License-Identifier: BSD-3-Clause OR GPL-2.0-only
#

choice
	bool "Watchdog timer"
	default WATCHDOG_SUN9I_A80_TWD if PLATFORM_H6
	default WATCHDOG_SUN50I_H713_WDT if PLATFORM_H713
	default WATCHDOG_SUN6I_A31_WDT
	help
		The firmware is monitored by a watchdog timer. If an
		error occurs, the watchdog will reset the system instead
		of allowing it to hang.

		The watchdog also services user-requested system resets.

config WATCHDOG_SUN50I_H713_WDT
	bool "R_WDOG of the H713 (reset; armed only for the sleep net)"
	depends on PLATFORM_H713
	help
		sun55i-a523 layout with the keys 0x16aa (CFG, MODE) and
		0xa57 (feed on CTRL +0x0c), measured on the SoC watchdog
		0x02051000; on the R_WDOG only CFG and MODE are known from
		the vendor firmware, which never arms it. The driver never
		arms it while awake; H713_SLEEP_NET arms it for a standby.

config WATCHDOG_SUN6I_A31_WDT
	bool "Watchdog (R_WDOG)"
	help
		This driver supports the watchdog in A31 and newer SoCs.

		This watchdog timer can reset the system after a minimum
		delay of one half second.

		Due to a bug in the H6 SoC, this watchdog timer hardware
		is used by other system software on that platform. When
		building for an H6 board, do not select this driver
		unless you know what you are doing.

config WATCHDOG_SUN9I_A80_TWD
	bool "Trusted watchdog (R_TWD)"
	depends on HAVE_R_TWD
	help
		This driver supports the trusted watchdog in A80 and
		newer SoCs.

		This watchdog timer can reset the system immediately.

		Older versions of Linux may interfere with this device,
		causing an unexpected reboot during system resume. As a
		workaround, select a different watchdog device.

endchoice
```

## platform/Kconfig
```kconfig
#
# Copyright © 2017-2022 The Crust Firmware Authors.
# SPDX-License-Identifier: BSD-3-Clause OR GPL-2.0-only
#

config PLATFORM
	string
	default "a23"  if PLATFORM_A23
	default "a64"  if PLATFORM_A64
	default "a83t" if PLATFORM_A83T
	default "h3"   if PLATFORM_H3
	default "h6"   if PLATFORM_H6
	default "h713" if PLATFORM_H713

choice
	prompt "Platform selection"

config PLATFORM_A23
	bool "A23/A33"
	depends on ARCH_OR1K
	select HAVE_R_RSB

config PLATFORM_A64
	bool "A64/H5"
	depends on ARCH_OR1K
	select HAVE_DRAM_SUSPEND
	select HAVE_HDMI
	select HAVE_R_CIR
	select HAVE_R_TWD

config PLATFORM_A83T
	bool "A83T"
	depends on ARCH_OR1K
	select HAVE_HDMI
	select HAVE_R_CIR
	select HAVE_R_RSB
	select HAVE_R_TWD
	select HAVE_UART4

config PLATFORM_H3
	bool "H3"
	depends on ARCH_OR1K
	select HAVE_DRAM_SUSPEND
	select HAVE_HDMI
	select HAVE_R_CIR
	select HAVE_R_TWD

config PLATFORM_H6
	bool "H6"
	depends on ARCH_OR1K
	select HAVE_DCXO
	select HAVE_DRAM_SUSPEND
	select HAVE_HDMI
	select HAVE_R_CIR
	select HAVE_R_RSB
	select HAVE_R_TWD

config PLATFORM_H713
	bool "H713 (TV303 projectors)"
	depends on ARCH_OR1K
	select HAVE_DCXO
	select HAVE_R_CIR
	help
		Allwinner H713 (sun50iw12): the R domain of the D1
		generation, an HDMI receiver front end owned by the ARISC.
		Deep sleep is not ported yet (no DRAM self-refresh).

endchoice

source "a23/Kconfig"
source "a64/Kconfig"
source "h713/Kconfig"

config HAVE_DCXO
	bool
	help
		Select this option on platforms with a DCXO in the RTC
		domain in addition to X24M pads in the PLL domain.

config HAVE_DRAM_SUSPEND
	bool
	help
		Select this option on platforms with the ability to
		suspend the DRAM controller.

config HAVE_HDMI
	bool
	help
		Select this option on platforms with an HDMI controller.

config HAVE_R_CIR
	bool
	help
		Select this option on platforms with a consumer infrared
		(CIR) controller.

config HAVE_R_I2C
	bool
	default y
	help
		Select this option on platforms with an R_I2C controller.

config HAVE_R_RSB
	bool
	help
		Select this option on platforms with an RSB controller.

config HAVE_R_TWD
	bool
	help
		Select this option on platforms with a trusted watchdog.

config HAVE_UART4
	bool
	help
		Select this option on platforms with a UART4.
```

## platform/h713/Kconfig
```kconfig
#
# Copyright © 2026 The Crust Firmware Authors.
# SPDX-License-Identifier: BSD-3-Clause OR GPL-2.0-only
#

if PLATFORM_H713

config H713_HDMI
	bool "HDMI front end contract of the vendor ARISC firmware"
	default y
	help
		Speak the message-box protocol of Allwinner's TV303 ARISC
		firmware on msgbox port 0 (EDID store, hot-plug pin, DDC
		RAM) and port 3 (startup handshake, cpu op req, restore
		finished), so that the Linux driver sun50i-h713-arisc
		keeps working unchanged.

config H713_IR_WAKE_NECX
	bool "Wake from standby on the projector remote (extended NEC)"
	depends on CIR
	default y
	help
		Compare received NEC codes against the vendor's cir_param
		list of the HY310/HY300 Pro (19 address/command pairs).

config H713_POWER_KEY_PIN
	int "Port L pin of the power key (level, active low)"
	default 4
	range 0 31
	help
		standby_param power_key = "PL4" on every board seen.

config H713_LED_RED_PIN
	int "Port L pin of the red standby LED, -1 = none"
	default -1
	range -1 31
	help
		High while asleep, low after the wake. The HY310's stock
		U-Boot prj node has it on PL0; no other board has been read
		(PRUEFUNG5 N-08), and crust drives no pin it does not know.

config H713_LED_BLUE_PIN
	int "Port L pin of the blue LED, -1 = none"
	default -1
	range -1 31
	help
		Low while asleep, high after the wake. HY310: PL1.

config H713_RAILS_PIN
	int "Port L pin the vendor standby_param names for all rails, -1 = never drive it"
	default -1
	range -1 31
	help
		standby_param on the HY310 and HY300 Pro puts vdd-cpu,
		vdd-sys, vcc-pll and vcc-dram all on PL6. What hangs on it
		is unmeasured (FB-STANDBY 7.5). No code reads this option:
		it records the board fact, and crust never touches the pin.

config H713_BOARD_ID
	int "Board in the build word (BUILD2 15..12): 1 HY310, 2 HY300 Pro, 3 HY200 QZ713DF A1, 4 HY320"
	default 0
	range 0 15
	help
		Lets the kernel and the build gates tell an image built for
		one board from one built for another (0 = not said).

config H713_DRAM_SELF_REFRESH
	bool "Put the DRAM into self-refresh in standby (vendor V1.15 port)"
	help
		The vendor ARISC firmware's DRAM standby driver (blob
		0x142dc enter, 0x145b0 exit), ported register by register
		and checked against the blob in an offline model only. Off,
		standby leaves the DRAM clocked ("light standby"). The DRAM
		parameters below must be the ones the boot loader trained
		the DRAM with.

config H713_DEEP_SLEEP
	bool "Deep sleep: root clocks to OSC24M and the PLLs off (not for a release)"
	depends on H713_DRAM_SELF_REFRESH
	help
		Part of the vendor's standby (blob 0xdd20 down, 0xe3f4, the
		MBUS rebuild and 0xde7c..0xde8c up): bus and root clocks to
		OSC24M, every PLL off, the RTC's LOSC not touched (only
		read after the resume), and on the way back MBUS
		reset and rebuilt with the NSI and display-bus gates
		(sun50i-h713-ccu.c). The PLL LDO, VDD_SYS and AVCC steps of
		the blob come only with their own switches below. Ported,
		offline model only; no device run.

config H713_HOSC_IS_DCXO
	bool "HOSC is a DCXO that the PLL LDO step does not stop (unmeasured)"
	depends on H713_DEEP_SLEEP
	help
		The PLL LDO step is safe only if the 24 MHz clock does not
		come through the PLL domain. The HY310 has CRYSTAL_EN (R_PRCM
		0x244 bit 2) set, and RTC 0x160 (the H6's DCXO control) has
		never been read for this question (PRUEFUNG5 DEEP-08). No
		board is confirmed; no product defconfig sets this.

config H713_DEEP_PLL_LDO
	bool "Deep sleep: the PLL LDO off"
	depends on H713_DEEP_SLEEP && H713_HOSC_IS_DCXO
	help
		Blob 0xddbc down, 0xddec up. The HY310 has R_PRCM 0x244
		bit 2 (CRYSTAL_EN) set (read 07.10.2026): the 24 MHz clock
		may come through the PLL domain's pads, and upstream crust
		turns that path off before the LDO (PRUEFUNG4). Build word
		bit 28; TF-A and the kernel refuse such an image unless told
		otherwise.

config H713_DEEP_VDD_SYS
	bool "Deep sleep: VDD_SYS reset"
	depends on H713_DEEP_SLEEP
	help
		Blob 0xdea8 down, 0xe3a8 up, the reset alone (the gating has
		its own switch below). It resets the main domain - CCU
		gates, pin functions, UART0, the msgbox and the SoC watchdog
		- and mainline Linux restores none of it (PRUEFUNG4 PD-1,
		PD-3; PRUEFUNG5 design A: never in a suspend). Build word bit
		27; TF-A and the kernel always refuse such an image. Only for
		the trace comparison with the blob.

config H713_DEEP_AVCC_GATING
	bool "Deep sleep: AVCC and bit 8 gating (an experiment)"
	depends on H713_DEEP_SLEEP
	help
		The gating half of blob 0xdea8/0xe3a8: R_PRCM 0x250 bit 2
		(AVCC) and bit 8 set on the way down, cleared on the way up,
		without the VDD_SYS reset. Upstream crust gates AVCC only
		with OSC24M off, and the H713 sleeps on OSC24M; what bit 8
		gates is not known (PRUEFUNG5 DEEP-09). Build word bit 31;
		TF-A and the kernel refuse such an image unless told
		otherwise. Never for a release.

config H713_POWER_OFF
	bool "Power off through crust: the board rails off, the key wakes with a reset"
	depends on H713_HDMI
	help
		The vendor's "fake poweroff" (blob 0xeaa8, doku/187): on
		TF-A's SYSTEM_OFF request (port 3, type 0x19) the cluster
		goes down and the system state machine shuts down instead of
		suspending. On the way down the lamp/fan enable PB5 and the
		USB VBUS enable PL3 go low, as U-Boot's power gate leaves
		them, then the board's rail enable (stock standby_param:
		vdd-cpu, vdd-sys, vcc-pll and vcc-dram all on one pin) goes
		low. The power key or the remote wakes: the rail enable high,
		10 ms, RTC GP5 from "GATE" to "RUN1" and the R_WDOG reset, a
		warm start that U-Boot's gate boots through. BUILD2 bit 24
		tells TF-A it may ask.

config H713_POWER_OFF_RAILS_PIN
	int "Port L pin of the board's rail enable"
	depends on H713_POWER_OFF
	default 6
	range 0 31
	help
		PL6 on the HY310 and the HY200 QZ713DF A1 (both stock trees,
		standby_param). High runs the board; low cuts vdd-cpu,
		vdd-sys, vcc-pll and vcc-dram. The R domain (crust, R_PIO,
		the RTC) stays powered - the blob keeps running after it.

config H713_SLEEP_NET
	bool "Sleep net: the R_WDOG armed from the standby request to Linux's confirm"
	depends on DEBUG_RECORD_STEPS && WATCHDOG_SUN50I_H713_WDT
	help
		crust arms the R_WDOG when it takes the kernel's net request
		(0x25/0x26 with NET_REQ), feeds it at standby step boundaries
		and at most once a second in its loops, never inside a step,
		and disarms it on the kernel's confirm after the resume. A
		hang anywhere in between resets the SoC. The R_WDOG's feed,
		clock, interval and reset scope are unmeasured: not for a
		release before stage S0. Build word bit 29.

config H713_SLEEP_NET_INTERVAL
	hex "R_WDOG interval code (MODE bits 7..4)"
	depends on H713_SLEEP_NET
	default 0xb
	range 0x1 0xb
	help
		0xb is 16 s on the SoC watchdog (measured); what it gives on
		the R_WDOG is to be measured in stage S0b. BUILD2 23..16.

config H713_TEST
	bool "Test build (build word bit 30, never for a release)"
	help
		Switches for the device stages that provoke a failure on
		purpose. The kernel reports the bit as a test build; the
		release gates refuse it.

if H713_TEST

config H713_TEST_STARVE_NET
	bool "Stop feeding the sleep net 2 s into the sleep (stage N2)"
	depends on H713_SLEEP_NET

config H713_POWER_OFF_TEST_WAKE_S
	int "Power off: wake by itself after this many seconds (0 = never)"
	depends on H713_POWER_OFF
	default 0
	range 0 3600
	help
		For the device test of the power off: the box comes back by
		itself, which proves crust ran on through the rails off
		without anybody at the key. Uses the standby timer word.

config H713_TEST_PORT3_SILENT
	bool "Stop reading port 3 once a request is taken (stage N4)"
	help
		TF-A's cpu op req then stays in the FIFO, and its suspend
		error path has to reset the SoC; else the presleep budget
		does.

config H713_TEST_NO_RVBAR_KEEP
	bool "Leave the cores' start addresses to TF-A (stage N1b)"
	help
		The cluster up does not write back ALT_RVBAR of the four
		cores (0030); TF-A's cpu_on has to. The record of what the
		cluster up left (H713_SEEN_RVBAR) stays.

endif

if H713_DRAM_SELF_REFRESH

config H713_DRAM_CLK
	int "DRAM clock in MHz (U-Boot CONFIG_DRAM_CLK)"
	default 792

config H713_DRAM_TYPE
	int "DRAM type (3 DDR3, 6 LPDDR2, 7 LPDDR3)"
	default 3

config H713_DRAM_ZQ
	hex "dram_para.zq"
	default 0x007b7bfb

config H713_DRAM_ODT_EN
	hex "dram_para.odt_en"
	default 0x1

config H713_DRAM_PARA1
	hex "dram_para.para1"
	default 0x000010f4

config H713_DRAM_PARA2
	hex "dram_para.para2"
	default 0x04000000

config H713_DRAM_MR0
	hex "dram_para.mr0"
	default 0x1c70

config H713_DRAM_MR1
	hex "dram_para.mr1"
	default 0x40

config H713_DRAM_MR2
	hex "dram_para.mr2"
	default 0x18

config H713_DRAM_MR3
	hex "dram_para.mr3"
	default 0x0

config H713_DRAM_TPR5
	hex "dram_para.tpr5"
	default 0x48484848

config H713_DRAM_TPR6
	hex "dram_para.tpr6"
	default 0x48

config H713_DRAM_TPR9
	hex "dram_para.tpr9"
	default 0x0

config H713_DRAM_TPR13
	hex "dram_para.tpr13"
	default 0xb4016103

endif

endif
```
